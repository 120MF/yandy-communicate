## west.yml
```yaml
manifest:
  remotes:
    - name: zephyrproject-rtos
      url-base: https://github.com/zephyrproject-rtos
    - name: robomaster-dlmu
      url-base: https://github.com/RoboMaster-DLMU-CONE
    - name: origin
      url-base: yandy-communicate

  projects:
    - name: zephyr
      remote: zephyrproject-rtos
      revision: main
      import:
        name-allowlist:
          - cmsis
          - cmsis_6
          - hal_stm32

    - name: one-framework
      remote: robomaster-dlmu
      revision: main
      path: modules/lib/one-framework
      import: true


    - name: yandy-communicate
      url: yandy-communicate
      path: modules/lib/nodes/yandy-communicate
      revision: main

  self:
    path: yandy-communicate
```

## zephyr/Kconfig
```kconfig
config YANDY_COMMUNICATE
    bool "yandy-communicate node for OneFramework"
    select COMM_BRIDGE
    select BOARD_DJI_BOARD_C_USB_COMM
    depends on YANDY_GIMBAL
    depends on ONE_FRAMEWORK
    help
      Enable yandy-communicate node.

if YANDY_COMMUNICATE

module = YANDY_COMMUNICATE
module-str = YANDY_COMMUNICATE
source "subsys/logging/Kconfig.template.log_config"

endif # YANDY_COMMUNICATE
```
